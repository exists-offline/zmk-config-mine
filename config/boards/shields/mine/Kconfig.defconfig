## config/boards/shields/mine/Kconfig.defconfig
```kconfig
if SHIELD_MINE_LEFT

config ZMK_KEYBOARD_NAME
    default "mine"

config ZMK_SPLIT_ROLE_CENTRAL
    default y

endif


if SHIELD_MINE_LEFT || SHIELD_MINE_RIGHT

config ZMK_SPLIT
    default y

endif
```

## config/boards/shields/mine/Kconfig.shield
```kconfig
config SHIELD_MINE_LEFT
    def_bool $(shields_list_contains,mine_left)

config SHIELD_MINE_RIGHT
    def_bool $(shields_list_contains,mine_right)
```
